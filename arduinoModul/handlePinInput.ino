/*************************************************************
* Функция проверяет корректность пинкода, его верность ввода *
* и вызывает функцию обработки платежа.                      *
*************************************************************/

void handlePinInput(  char customKey,         ///< customKey - символ с клавиатуры
                      int &i,                 ///< i - положение курсора на дисплее
                      String &pincodeString,  ///< pincodeString - буффер пинкода
                      int &attemptCounter)    ///< attemptCounter - счетчик неудачных попыток
{
  Serial.println(1);
  if (customKey != KEY_HASH && customKey != KEY_STAR)   //проверяем на функциональные клавиши KEY_STAR == "*", KEY_HACH = "#""
  {
    lcd.setCursor(i, 1);                                //устанавливаем курсор на начало второй строки
    lcd.print(customKey);                               //выводим на экран введеный символ пинкода
    i++;                                                //прибавляем в счетчик для перемещения курсора экрана
    pincodeString += customKey;                         //добавляем в буффер введенный символ
  }

  else if (customKey == KEY_STAR)                       //удаление введенного символа в экране
  {
    if (i > 0)                                          // проверка на минимальное значение (возможно символов вовсе нет)
    {
      i--;
      lcd.setCursor(i, 1);                              // установка курсора под следующий введенный символ
      lcd.print(" ");                                   // заполнение строки на экране пустотой
      pincodeString.remove(pincodeString.length() - 1); // удаление удаленного символа из буффера 
    }                                                   //если экран был пуст, то выходим из условия
  }

  else                                                  //при отправки пинкода на сервер
  {

    if(pincodeString.length() != PIN_LENGTH)            //проверка на длину пинкода
    {
      i = 0;                                            //возвращаем курсор в стартовую позици 0, 0
      pincodeString = "";                               //очищаем буффер после неккоректного ввода пинкода
      attemptCounter++;
      displayMessage("Error input", true,0,0,true);     //выводи сообщение об ошибке ввода пинкода
    }


    else                                                //если пинкод корректный (4 символа)
    {
      processPayment(pincodeString, attemptCounter);    //вызываем функцию транзакции
      i = 0;                                            //возвращаем курсор в стартовую позици 0, 0
    }
  }
}